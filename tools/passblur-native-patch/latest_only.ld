SECTIONS
{
  . = 0x00a4f200;
  .text : { *(.text) }
  /DISCARD/ : { *(.note*) *(.comment*) }
}

STATE_BASE = ABSOLUTE(0x00ab1000);
ORIG_SUBMIT_CONT = ABSOLUTE(0x0054eba4);
ORIG_CLOSURE_CONT = ABSOLUTE(0x005591b4);
ORIG_DEQUEUE_CONT = ABSOLUTE(0x00422bc4);
ORIG_SETTEX_CONT = ABSOLUTE(0x00422134);
